## main/Kconfig.projbuild
```kconfig
menu "Picture Weather Station"

    config PWS_WIFI_SSID
        string "WiFi SSID"
        default ""
        help
            SSID (network name) to connect to.

	config PWS_WIFI_PASSWORD
		string "WiFi Password"
		default ""
		help
			WiFi password (WPA2).

    config PWS_RUUVI_SIGNATURE
        hex "Ruuvi Tag BLE signature (4 hex digits)"
        default 0x0
        range 0x0000 0xFFFF
        help
            The 4 hex-digit MAC address tail (advertised by the Ruuvi Tag as local name suffix)
            (e.g. "E524").

    config PWS_LAT
        string "Latitude"
        default "60.25"
        help
            Latitude coordinate for weather station location (decimal degrees, e.g. "60.1699").

    config PWS_LON
        string "Longitude"
        default "20.27"
        help
            Longitude coordinate for weather station location (decimal degrees, e.g. "24.9384").

    config PWS_ADAFRUIT_IO_USER
        string "Adafruit IO username"
        default ""
        help
            Adafruit IO account username.

    config PWS_ADAFRUIT_IO_KEY
        string "Adafruit IO key"
        default ""
        help
            Adafruit IO active key (from io.adafruit.com settings).

    config PWS_ADAFRUIT_IO_FEED_KEY
        string "Adafruit IO feed key"
        default ""
        help
            Key of the Adafruit IO feed to read (e.g. "outdoor-temp").

endmenu
```

## sdkconfig.defaults
```kconfig
# 16 MB flash, custom partition table
CONFIG_ESPTOOLPY_FLASHSIZE_16MB=y
CONFIG_PARTITION_TABLE_CUSTOM=y
CONFIG_PARTITION_TABLE_CUSTOM_FILENAME="partitions.csv"

# Enable 8MB PSRAM
CONFIG_SPIRAM=y
CONFIG_SPIRAM_MODE_OCT=y
CONFIG_SPIRAM_SPEED_80M=y

# Enable Bluetooth with NimBLE in observer-only mode
CONFIG_BT_ENABLED=y
CONFIG_BT_NIMBLE_ENABLED=y
CONFIG_BT_BLUEDROID_ENABLED=n
CONFIG_BT_NIMBLE_MAX_CONNECTIONS=0
CONFIG_BT_NIMBLE_ROLE_OBSERVER=y
CONFIG_BT_NIMBLE_ROLE_CENTRAL=n
CONFIG_BT_NIMBLE_ROLE_PERIPHERAL=n
CONFIG_BT_NIMBLE_ROLE_BROADCASTER=n
CONFIG_LIBC_PRINTF_FLOAT_SUPPORT=y
```
